## boards/shields/Enigma_03/Kconfig.defconfig
```kconfig
if SHIELD_Enigma_03

# Basic
config ZMK_KEYBOARD_NAME
    default "Enigma_03"

config ZMK_USB
	default y

config ZMK_BLE
	default y

config ZMK_MOUSE
	default y

config ZMK_POINTING
	default y

config SPI
	default y

config INPUT
	default y

config NFCT_PINS_AS_GPIOS
	default y

endif
```

## config/west.yml
```yaml
manifest:
  remotes:
    - name: zmkfirmware
      url-base: https://github.com/zmkfirmware
    - name: nazuna293
      url-base: https://github.com/nazuna293
    - name: kot149
      url-base: https://github.com/kot149
    - name: kot149
      url-base: https://github.com/kot149
    - name: ssbb
      url-base: https://github.com/ssbb
    - name: caksoylar
      url-base: https://github.com/caksoylar  
  projects:
    - name: zmk
      remote: zmkfirmware
      revision: main
      import: app/west.yml
    - name: zmk-pmw3610-driver
      remote: nazuna293
      revision: main
    - name: zmk-layout-shift
      remote: kot149
      revision: v1
    - name: zmk-mouse-gesture
      remote: kot149
      revision: v1
    - name: zmk-listeners
      remote: ssbb
      revision: v1
    - name: zmk-rgbled-widget
      remote: caksoylar
      revision: main
  self:
    path: config
```
